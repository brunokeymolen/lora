#include <string.h>
#include <stdio.h>
#include <stdarg.h>
#include "freertos/FreeRTOS.h"
#include "freertos/task.h"
#include "driver/gpio.h"
#include "driver/i2c_master.h"
#include "esp_log.h"
#include "ssd1306.h"

static const char *TAG = "SSD1306";

#define SSD1306_INIT_RETRIES        5
#define SSD1306_POWER_SETTLE_MS     100
#define SSD1306_RETRY_DELAY_MS      50

static const uint8_t SSD1306_CANDIDATE_ADDRS[] = { 0x3C, 0x3D };

/* ── 5×7 font, column-major, ASCII 0x20–0x7E ───────────────────────────── */
static const uint8_t FONT5X7[][5] = {
    {0x00,0x00,0x00,0x00,0x00}, // 0x20  (space)
    {0x00,0x00,0x5F,0x00,0x00}, // 0x21  !
    {0x00,0x07,0x00,0x07,0x00}, // 0x22  "
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    {0x10,0x08,0x08,0x10,0x08}, // 0x7E  ~
};

/* ── Low-level helpers ─────────────────────────────────────────────────────── */

static esp_err_t write_cmd(ssd1306_t *dev, uint8_t cmd)
{
    uint8_t buf[2] = {0x00, cmd};
    return i2c_master_transmit(dev->dev, buf, 2, pdMS_TO_TICKS(100));
}

static esp_err_t write_data(ssd1306_t *dev, const uint8_t *data, size_t len)
{
    uint8_t *buf = malloc(len + 1);
    if (!buf) return ESP_ERR_NO_MEM;
    buf[0] = 0x40;
    memcpy(buf + 1, data, len);
    esp_err_t ret = i2c_master_transmit(dev->dev, buf, len + 1, pdMS_TO_TICKS(500));
    free(buf);
    return ret;
}

/* ── Initialisation ────────────────────────────────────────────────────────── */

esp_err_t ssd1306_init(ssd1306_t *dev, int sda_gpio, int scl_gpio, int vext_gpio, int rst_gpio)
{
    memset(dev, 0, sizeof(*dev));

    /* Power on the display's VEXT rail (active-LOW on Heltec V4) */
    if (vext_gpio >= 0) {
        gpio_config_t io = {
            .pin_bit_mask = (1ULL << vext_gpio),
            .mode = GPIO_MODE_OUTPUT,
            .pull_down_en = 0,
            .pull_up_en = 0,
            .intr_type = GPIO_INTR_DISABLE,
        };
        ESP_ERROR_CHECK(gpio_config(&io));
        gpio_set_level(vext_gpio, 0);   // LOW = power on
        vTaskDelay(pdMS_TO_TICKS(SSD1306_POWER_SETTLE_MS));
    }

    if (rst_gpio >= 0) {
        gpio_config_t rst = {
            .pin_bit_mask = (1ULL << rst_gpio),
            .mode = GPIO_MODE_OUTPUT,
            .pull_down_en = 0,
            .pull_up_en = 0,
            .intr_type = GPIO_INTR_DISABLE,
        };
        ESP_ERROR_CHECK(gpio_config(&rst));
        gpio_set_level(rst_gpio, 0);
        vTaskDelay(pdMS_TO_TICKS(20));
        gpio_set_level(rst_gpio, 1);
        vTaskDelay(pdMS_TO_TICKS(20));
    }

    /* Set up I2C master bus */
    i2c_master_bus_config_t bus_cfg = {
        .clk_source = I2C_CLK_SRC_DEFAULT,
        .i2c_port = I2C_NUM_0,
        .sda_io_num = sda_gpio,
        .scl_io_num = scl_gpio,
        .glitch_ignore_cnt = 7,
        .flags.enable_internal_pullup = true,
    };
    ESP_ERROR_CHECK(i2c_new_master_bus(&bus_cfg, &dev->bus));

    esp_err_t ret = ESP_FAIL;
    uint8_t detected_addr = 0;
    for (size_t addr_idx = 0; addr_idx < sizeof(SSD1306_CANDIDATE_ADDRS); addr_idx++) {
        uint8_t candidate_addr = SSD1306_CANDIDATE_ADDRS[addr_idx];

        for (int attempt = 1; attempt <= SSD1306_INIT_RETRIES; attempt++) {
            ret = i2c_master_probe(dev->bus, candidate_addr, 100);
            if (ret == ESP_OK) {
                detected_addr = candidate_addr;
                break;
            }

            ESP_LOGW(TAG, "Probe 0x%02X attempt %d/%d failed: %s",
                     candidate_addr, attempt, SSD1306_INIT_RETRIES, esp_err_to_name(ret));
            i2c_master_bus_reset(dev->bus);
            vTaskDelay(pdMS_TO_TICKS(SSD1306_RETRY_DELAY_MS));
        }

        if (detected_addr != 0) {
            break;
        }
    }
    if (ret != ESP_OK) {
        ESP_LOGE(TAG, "SSD1306 probe failed on 0x3C/0x3D: %s", esp_err_to_name(ret));
        return ret;
    }

    ESP_LOGI(TAG, "SSD1306 found at 0x%02X", detected_addr);

    i2c_device_config_t dev_cfg = {
        .dev_addr_length = I2C_ADDR_BIT_LEN_7,
        .device_address = detected_addr,
        .scl_speed_hz = 400000,
    };
    ESP_ERROR_CHECK(i2c_master_bus_add_device(dev->bus, &dev_cfg, &dev->dev));

    /* SSD1306 init sequence for 128×64 */
    static const uint8_t init_cmds[] = {
        0xAE,        // display off
        0xD5, 0x80,  // clock div / osc freq
        0xA8, 0x3F,  // multiplex ratio 64
        0xD3, 0x00,  // display offset 0
        0x40,        // start line 0
        0x8D, 0x14,  // charge pump on
        0x20, 0x00,  // horizontal addressing mode
        0xA1,        // segment remap (col 127 = SEG0)
        0xC8,        // COM scan direction remapped
        0xDA, 0x12,  // COM pins alt config
        0x81, CONFIG_OLED_CONTRAST, // contrast
        0xD9, 0xF1,  // pre-charge period
        0xDB, 0x40,  // VCOM deselect
        0xA4,        // resume to RAM
        0xA6,        // normal display
        0xAF,        // display on
    };
    for (size_t i = 0; i < sizeof(init_cmds); i++) {
        ret = write_cmd(dev, init_cmds[i]);
        if (ret != ESP_OK) {
            ESP_LOGE(TAG, "Init cmd 0x%02X failed: %s", init_cmds[i], esp_err_to_name(ret));
            return ret;
        }
    }

    ssd1306_clear(dev);
    ESP_LOGI(TAG, "SSD1306 ready");
    return ESP_OK;
}

/* ── Framebuffer operations ────────────────────────────────────────────────── */

void ssd1306_clear(ssd1306_t *dev)
{
    memset(dev->fb, 0, sizeof(dev->fb));
    ssd1306_flush(dev);
}

void ssd1306_flush(ssd1306_t *dev)
{
    for (uint8_t page = 0; page < SSD1306_PAGES; page++) {
        write_cmd(dev, 0xB0 | page);   // set page
        write_cmd(dev, 0x00);           // col low nibble = 0
        write_cmd(dev, 0x10);           // col high nibble = 0
        write_data(dev, dev->fb[page], SSD1306_WIDTH);
    }
}

/* ── Text rendering ────────────────────────────────────────────────────────── */

void ssd1306_putchar(ssd1306_t *dev, uint8_t col, uint8_t row, char c)
{
    if (row >= SSD1306_PAGES || col >= SSD1306_COLS) return;
    if (c < 0x20 || c > 0x7E) c = 0x20;

    uint16_t px = col * 6;           // pixel x offset
    const uint8_t *glyph = FONT5X7[c - 0x20];
    for (uint8_t i = 0; i < 5; i++) {
        dev->fb[row][px + i] = glyph[i];
    }
    dev->fb[row][px + 5] = 0x00;     // 1-px gap
}

void ssd1306_puts(ssd1306_t *dev, uint8_t col, uint8_t row, const char *str)
{
    while (*str) {
        if (col >= SSD1306_COLS) { col = 0; row++; }
        if (row >= SSD1306_PAGES) break;
        ssd1306_putchar(dev, col++, row, *str++);
    }
}

void ssd1306_printf(ssd1306_t *dev, uint8_t row, const char *fmt, ...)
{
    char buf[SSD1306_COLS + 1];
    va_list args;
    va_start(args, fmt);
    vsnprintf(buf, sizeof(buf), fmt, args);
    va_end(args);
    /* Pad with spaces to clear remainder of row */
    size_t len = strlen(buf);
    for (size_t i = len; i < SSD1306_COLS; i++) buf[i] = ' ';
    buf[SSD1306_COLS] = '\0';
    ssd1306_puts(dev, 0, row, buf);
}

void ssd1306_power(ssd1306_t *dev, bool on)
{
    write_cmd(dev, on ? 0xAF : 0xAE);
}
